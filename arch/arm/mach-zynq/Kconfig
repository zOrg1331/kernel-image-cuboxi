## arch/arm/mach-zynq/Kconfig
```kconfig
if ARCH_ZYNQ

choice
        prompt "Board Selection"
	default MACH_XILINX_EP107

config MACH_XILINX_EP107
	bool "Xilinx EP107 Board"
	help
	  Select if you are using a Xilinx EP107 board.

endchoice

endif
```

## arch/arm/plat-mxc/Kconfig
```kconfig
if ARCH_MXC

source "arch/arm/plat-mxc/devices/Kconfig"

menu "Freescale MXC Implementations"

config ARCH_MX50_SUPPORTED
	bool

config ARCH_MX53_SUPPORTED
	bool

choice
	prompt "Set of supported SoCs:"
	default ARCH_MX3

# don't use the symbols available in this choice in code. They should only be
# used to select the machines that can be compiled into a single kernel.
config ARCH_MX1
	bool "MX1"
	help
	  This enables support for systems based on the Freescale i.MX1 family

config MACH_MX21
	bool "i.MX21"
	help
	  This enables support for machines using Freescale's i.MX21 processor.

config ARCH_MX25
	bool "i.MX25"
	help
	  This enables support for machines using Freescale's i.MX25 processor.

config MACH_MX27
	bool "i.MX27"
	help
	  This enables support for machines using Freescale's i.MX27 processor.

config ARCH_MX3
	bool "i.MX31 + i.MX35"
	help
	  This enables support for machines using Freescale's i.MX31 and i.MX35
	  processors.

config ARCH_MX503
	bool "i.MX50 + i.MX53"
	select ARCH_MX50_SUPPORTED
	select ARCH_MX53_SUPPORTED
	help
	  This enables support for machines using Freescale's i.MX50 and i.MX51
	  processors.

config ARCH_MX51
	bool "i.MX51"
	select ARCH_MX51_SUPPORTED
	help
	  This enables support for systems based on the Freescale i.MX51 family

endchoice

source "arch/arm/mach-imx/Kconfig"
source "arch/arm/mach-mx5/Kconfig"

endmenu

config MXC_IRQ_PRIOR
	bool "Use IRQ priority"
	help
	  Select this if you want to use prioritized IRQ handling.
	  This feature prevents higher priority ISR to be interrupted
	  by lower priority IRQ even IRQF_DISABLED flag is not set.
	  This may be useful in embedded applications, where are strong
	  requirements for timing.
	  Say N here, unless you have a specialized requirement.

config MXC_TZIC
	bool

config MXC_AVIC
	bool

config MXC_PWM
	tristate "Enable PWM driver"
	select HAVE_PWM
	help
	  Enable support for the i.MX PWM controller(s).

config MXC_DEBUG_BOARD
	bool "Enable MXC debug board(for 3-stack)"
	help
	  The debug board is an integral part of the MXC 3-stack(PDK)
	  platforms, it can be attached or removed from the peripheral
	  board. On debug board, several debug devices(ethernet, UART,
	  buttons, LEDs and JTAG) are implemented. Between the MCU and
	  these devices, a CPLD is added as a bridge which performs
	  data/address de-multiplexing and decode, signal level shift,
	  interrupt control and various board functions.

config HAVE_EPIT
	bool

config MXC_USE_EPIT
	bool "Use EPIT instead of GPT"
	depends on HAVE_EPIT
	help
	  Use EPIT as the system timer on systems that have it. Normally you
	  don't have a reason to do so as the EPIT has the same features and
	  uses the same clocks as the GPT. Anyway, on some systems the GPT
	  may be in use for other purposes.

config MXC_ULPI
	bool

config ARCH_HAS_RNGA
	bool

config IMX_HAVE_IOMUX_V1
	bool

config ARCH_MXC_IOMUX_V3
	bool

config ARCH_MXC_AUDMUX_V1
	bool

config ARCH_MXC_AUDMUX_V2
	bool

config IRAM_ALLOC
	bool
	select GENERIC_ALLOCATOR

endif
```

## drivers/als/Kconfig
```kconfig
#
# Ambient Light Sensor sysfs device configuration
#

menuconfig ALS
	tristate "Ambient Light Sensor sysfs device"
	help
	  This framework provides a generic sysfs I/F for Ambient Light
	  Sensor devices.
	  If you want this support, you should say Y or M here.

if ALS

config ALS_ISL29003
	tristate "Intersil ISL29003 ambient light sensor"
	depends on I2C && SYSFS
	help
	  If you say yes here you get support for the Intersil ISL29003
	  ambient light sensor.

	  This driver can also be built as a module.  If so, the module
	  will be called isl29003.

config ALS_TSL2550
	tristate "Taos TSL2550 ambient light sensor"
	depends on EXPERIMENTAL && I2C
	help
	  If you say yes here you get support for the Taos TSL2550
	  ambient light sensor.

	  This driver can also be built as a module.  If so, the module
	  will be called tsl2550.

endif #ALS
```

## drivers/base/regmap/Kconfig
```kconfig
# Generic register map support.  There are no user servicable options here,
# this is an API intended to be used by other kernel subsystems.  These
# subsystems should select the appropriate symbols.

config REGMAP
	default y if (REGMAP_I2C || REGMAP_SPI)
	select LZO_COMPRESS
	select LZO_DECOMPRESS
	bool

config REGMAP_I2C
	tristate

config REGMAP_SPI
	tristate

config REGMAP_IRQ
	bool

config REGMAP_DEBUG_FS
	bool "Debugfs support for Generic register map"
	depends on REGMAP && DEBUG_FS
	default y
```

## drivers/block/rxdsk/Kconfig
```kconfig
config BLK_DEV_RXDSK
	tristate "RapidDisk RAM disk support"
	default n
	help
	  RapidDisk or rxdsk was designed to be used in high performing
	  environments and has been designed with simplicity in mind.
	  Utilizing a user land binary, the system administrator is capable
	  of dynamically adding new RAM based block devices of varying sizes,
	  removing existing ones to even listing all existing RAM block devices.
	  The rxdsk module has been designed to allocate from the system's memory
	  pages and is capable of addressing memory to support Gigabytes if not
	  a Terabyte of available Random Access Memory.

	  If unsure, say N.

config BLK_DEV_RXCACHE
	tristate "RapidCache support"
	default n
	help
	  RapidCache or rxcache is designed to leverage the high speed performing
	  technologies of the RapidDisk RAM disk and utilizing the Device Mapper
	  framework, map an rxdsk volume to act as a block device's
	  Write/Read-through cache. This can significantly boost the performance
	  of a local or remote disk device.

	  If unsure, say N.
```

## drivers/misc/emlog/Kconfig
```kconfig
config EMLOG
	tristate "EMbedded-system LOG-device support"
	default n
	help
	  emlog is a module that makes it easy to access the most recent
	  (and *only* the most recent) output from a process. It works just like
	  "tail -f" on a log file, except that the storage required never grows.
	  This can be useful in embedded systems where there isn't enough memory
	  or disk space for keeping complete log files, but the most recent
	  debugging messages are sometimes needed (e.g., after an error is
	  observed).

	  If unsure, say N.
```

## drivers/platform/x86/omnibook/Kconfig
```kconfig
config OMNIBOOK
       tristate "HP Omnibook and Toshiba laptop support"
       depends on PCI && X86 && EXPERIMENTAL
       ---help---
          This adds a driver to support some features of laptops such as 
	  HP OmniBook, Pavilion, Compal ACL00 ,Toshiba Satellite which have 
	  a Phoenix BIOS and are not supported by other Toshiba drivers
          and some Acer Aspire series laptops.

	  Most of these are manufactured by Compal Electronics, Inc as ODM
          
	  See  <http://www.sf.net/projects/omnibook/>.

          Say Y if you intend to run this kernel on a supported portable.
          Say N otherwise.

          This driver is also available as a module ( = code which can be
          inserted in and removed from the running kernel whenever you want).
          If you want to compile it as a module, say M here and read
          Documentation/modules.txt.
          
	  The module is called omnibook.ko due to historical reasons.

config OMNIBOOK_LEGACY
       bool "HP omnibook legacy features"
       depends on OMNIBOOK
       default y if !ACPI
       ---help---
	 This option enable support for some legacy features of the omnibook
         driver, including:
         * /proc/apm emulation.
	 * non-ACPI support code.
	 * AC adapter and Battery monitoring default enabling.
	 This is mainly for laptops with no or broken ACPI support.

	 If you are unsure, say N.

config OMNIBOOK_BACKLIGHT
       bool "HP omnibook backlight support"
       depends on OMNIBOOK
       select BACKLIGHT_CLASS_DEVICE
       default y
       ---help---
         Enable registration of the omnibook module as a backlight device.
         This allow query and control of the LCD brightness via sysfs.
	 
	 If you are unsure, say Y.
```

## drivers/staging/rt2860/Kconfig
```kconfig
config RT2860
	tristate "Ralink 2860 wireless support"
	depends on PCI && X86 && WLAN_80211
	select CRC_CCITT
	select FW_LOADER
	---help---
	  This is an experimental driver for the Ralink 2860 wireless chip.
```

## drivers/staging/rtl8187se/Kconfig
```kconfig
config R8187SE
	tristate "RealTek RTL8187SE Wireless LAN NIC driver"
	depends on PCI && WLAN
	depends on WIRELESS_EXT
	default N
	---help---
	  If built as a module, it will be called r8187se.ko.
```

## drivers/staging/vt6655/Kconfig
```kconfig
config VT6655
   tristate "VIA Technologies VT6655 support"
   depends on WIRELESS_EXT && PCI && WLAN
   ---help---
   This is a vendor-written driver for VIA VT6655.
```

## fs/ceph/Kconfig
```kconfig
config CEPH_FS
        tristate "Ceph distributed file system (EXPERIMENTAL)"
	depends on INET && EXPERIMENTAL
	select LIBCRC32C
	select CONFIG_CRYPTO_AES
	help
	  Choose Y or M here to include support for mounting the
	  experimental Ceph distributed file system.  Ceph is an extremely
	  scalable file system designed to provide high performance,
	  reliable access to petabytes of storage.

	  More information at http://ceph.newdream.net/.

	  If unsure, say N.

config CEPH_FS_PRETTYDEBUG
	bool "Include file:line in ceph debug output"
	depends on CEPH_FS
	default n
	help
	  If you say Y here, debug output will include a filename and
	  line to aid debugging.  This icnreases kernel size and slows
	  execution slightly when debug call sites are enabled (e.g.,
	  via CONFIG_DYNAMIC_DEBUG).

	  If unsure, say N.

config CEPH_RBD
	bool "Rados block device (RBD)"
	depends on CEPH_FS
	select  CONFIG_BLOCK
	default y
	help
	  If you say Y here, ceph will include rbd, the RADOS block
	  device which stripes a block device over objects stored in
	  the Ceph distributed object store.
```

## fs/dazukofs/Kconfig
```kconfig
config DAZUKOFS
	tristate "Dazuko stackable filesystem support"
	help
	  DazukoFS is a stackable filesystem to allow userspace applications to
	  perform online file access control. It was originally developed to
	  support online virus scanners, but could be useful for any application
	  that wishes to perform online file access control.
```

## net/ceph/Kconfig
```kconfig
config CEPH_LIB
        tristate "Ceph core library (EXPERIMENTAL)"
	depends on INET && EXPERIMENTAL
	select LIBCRC32C
	select CRYPTO_AES
	default n
	help
	  Choose Y or M here to include cephlib, which provides the
	  common functionality to both the Ceph filesystem and
	  to the rados block device (rbd).

	  More information at http://ceph.newdream.net/.

	  If unsure, say N.
```

## net/netatop/Kconfig
```kconfig
config NETATOP
	tristate "module for gather statistics about the TCP and UDP packets"
	default n
	help
	  Module netatop for gather statistics about the TCP and UDP packets that
	  have been transmitted/received per process and per thread.
```
